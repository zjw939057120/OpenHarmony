## device/board/yukon/gd32f470/Kconfig.liteos_m.board
```kconfig
menuconfig BOARD_GD32F470
    bool "select board gd32f470"
    depends on SOC_GD32F470
```

## device/board/yukon/gd32f470/Kconfig.liteos_m.defconfig.board
```kconfig
if BOARD_GD32F470
config BOARD
    string
    default "gd32f470"

endif #BOARD_GD32F470
```

## device/board/yukon/gd32f470zi/Kconfig.liteos_m.board
```kconfig
menuconfig BOARD_GD32F470
    bool "select board gd32f470zi"
    depends on SOC_GD32F470
```

## device/board/yukon/gd32f470zi/Kconfig.liteos_m.defconfig.board
```kconfig
if BOARD_GD32F470
config BOARD
    string
    default "gd32f470zi"

endif #BOARD_GD32F470
```

## device/soc/gd/Kconfig.liteos_m.soc
```kconfig
config SOC_COMPANY_GDMICROELECTRONICS
    bool
if SOC_COMPANY_GDMICROELECTRONICS
config SOC_COMPANY
    default "gd"
rsource "*/Kconfig.liteos_m.soc"
endif # SOC_COMPANY_GDMICROELECTRONICS
```

## device/soc/gd/gd32f4xx/Kconfig.liteos_m.defconfig.series
```kconfig
if SOC_SERIES_GD32F4xx
rsource "Kconfig.liteos_m.defconfig.gd32f4xx"
config SOC_SERIES
    string
    default "gd32f4xx"
endif
```

## device/soc/gd/gd32f4xx/Kconfig.liteos_m.series
```kconfig
config SOC_SERIES_GD32F4xx
    bool "GDMicroelectronics GD32F4xx series"
    select ARCH_ARM
    select SOC_COMPANY_GDMICROELECTRONICS
    select CPU_CORTEX_M4
    help
        Enable support for GDMicroelectronics GD32F4xx series
```

## device/soc/gd/gd32f4xx/Kconfig.liteos_m.soc
```kconfig
choice
    prompt "GDMicroelectronics GD32F4xx series SoC"
    depends on SOC_SERIES_GD32F4xx
config SOC_GD32F470
    bool "SoC GD32F470"
endchoice
```
